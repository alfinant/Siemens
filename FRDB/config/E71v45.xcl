-carm
-Z(CODE)ICODE,CODE,DATA_I,DATA_ID,INITTAB,DATA_C=A0050450

-Z(CODE)PATCH_ONMESSAGE=A08479F4
-Z(CODE)PATCH_MAINCSMSIZE=0xA0847A10
-Z(CODE)PATCH_PREDIAL=A06ED3C4
-Z(CODE)PREDIAL_JUMP=0xA06ED41C
-Z(CODE)PATCH_START=A063B720
-Z(CODE)PATCH_START_JUMP=A063BF74
-Z(CODE)PATCH_ITEM_NAME=A063B696
-Z(CODE)PATCH_APM_FRDB_GetInfo1=A0635492
-Z(CODE)GetInfo1_JUMP=A06354B8
-Z(CODE)PATCH_APM_FRDB_GetInfo2=A06EA404
-Z(CODE)GetInfo2_JUMP=A06EA41E
-Z(CODE)PATCH_APM_FileRef_Run_UNKNOWN=A06EA6A8
-Z(CODE)UNKNOWN_JUMP=A06EA6DA
-Z(CODE)PATCH_APM_FileRef_Run_SOUND=A06EA760
-Z(CODE)SOUND_JUMP=A06EA78A
-Z(CODE)PATCH_APM_FileRef_Run_VIDEOIMAGE=A06EA796
