-carm
-Z(CODE)ICODE,CODE,DATA_I,DATA_ID,INITTAB,DATA_C=A1448000

-Z(CODE)PATCH_ONMESSAGE=A042B85C
-Z(CODE)PATCH_MAINCSMSIZE=A042B878
-Z(CODE)PATCH_PREDIAL_ENA1=A0332F8A
-Z(CODE)PATCH_PREDIAL_ENA2=A0332F8E
-Z(CODE)PREDIAL_JUMP=A0332FE4
-Z(CODE)PATCH_START=A02CE738
-Z(CODE)PATCH_START_JUMP=A0438E28
-Z(CODE)PATCH_ITEM_NAME=A02CE6AE 
-Z(CODE)PATCH_APM_FRDB_GetInfo1=A02C8F7A
-Z(CODE)GetInfo1_JUMP=A02C8FA0
-Z(CODE)PATCH_APM_FRDB_GetInfo2=A03303F0
-Z(CODE)GetInfo2_JUMP=A033040E
-Z(CODE)PATCH_APM_FileRef_Run_UNKNOWN=A033066E
-Z(CODE)UNKNOWN_JUMP=A03306A0
-Z(CODE)PATCH_APM_FileRef_Run_SOUND=A0330726
-Z(CODE)SOUND_JUMP=A0330750
-Z(CODE)PATCH_APM_FileRef_Run_VIDEOIMAGE=A033075C