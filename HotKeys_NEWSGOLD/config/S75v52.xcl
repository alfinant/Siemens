-carm
-Z(CODE)ICODE,CODE,DATA_I,DATA_ID,INITTAB,DATA_C=A1448000

-Z(CODE)PATCH_ONMESSAGE=A042B85C
-Z(CODE)PATCH_MAINCSMSIZE=A042B878
-Z(CODE)PATCH_PREDIAL_ENA1=A0332F8A
-Z(CODE)PATCH_PREDIAL_ENA2=A0332F8E
-Z(CODE)PATCH_APM_FRDB_GetInfo1=A02C8F7A
-Z(CODE)J_GetInfo1=A02C8FA0
-Z(CODE)PATCH_APM_FRDB_GetInfo2=A03303F0
-Z(CODE)J_GetInfo2=A033040E
-Z(CODE)PATCH_APM_FileRef_Run_UNKNOWN=A033066E
-Z(CODE)J_UNKNOWN=A03306A0
-Z(CODE)PATCH_APM_FileRef_Run_SOUND=A0330726
-Z(CODE)J_SOUND=A0330750
-Z(CODE)PATCH_APM_FileRef_Run_VIDEOIMAGE=A033075C

-Z(CODE)ExecuteFile=A04D4898