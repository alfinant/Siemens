-carm
-Z(CODE)ICODE,CODE,DATA_I,DATA_ID,INITTAB,DATA_C=A0050450

-Z(CODE)PATCH_ONMESSAGE=A08479F4
-Z(CODE)PATCH_MAINCSMSIZE=0xA0847A10
-Z(CODE)PATCH_PREDIAL_ENA1=A06ED3C2
-Z(CODE)PATCH_PREDIAL_ENA2=A06ED3C6
-Z(CODE)PATCH_APM_FRDB_GetInfo1=A0635492
-Z(CODE)J_GetInfo1=A06354B8
-Z(CODE)PATCH_APM_FRDB_GetInfo2=A06EA404
-Z(CODE)J_GetInfo2=A06EA41E
-Z(CODE)PATCH_APM_FileRef_Run_UNKNOWN=A06EA6A8
-Z(CODE)J_UNKNOWN=A06EA6DA
-Z(CODE)PATCH_APM_FileRef_Run_SOUND=A06EA760
-Z(CODE)J_SOUND=A06EA78A
-Z(CODE)PATCH_APM_FileRef_Run_VIDEOIMAGE=A06EA796

-Z(CODE)ExecuteFile=A0502D7C