-carm
-Z(CODE)ICODE,CODE,DATA_I,DATA_ID,INITTAB,DATA_C=A00A6490

-Z(CODE)PATCH_MENU_ONMESSAGE=A04B4B38
-Z(CODE)PATCH_MENU_MAINCSMSIZE=A04B4B44
-Z(CODE)PATCH_MENU_PREDIAL_ENA=A03B30B4
-Z(CODE)PATCH_IDLE_START_XTRA_JC=A02B7932
-Z(CODE)PATCH_SET_FILE_NAME=A0326E0A
