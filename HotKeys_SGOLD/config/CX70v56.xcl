-carm
-Z(CODE)ICODE,CODE,DATA_I,DATA_ID,INITTAB,DATA_C=A0800010

-Z(CODE)PATCH_MENU_ONMESSAGE=A0947EAC
-Z(CODE)PATCH_MENU_MAINCSMSIZE=A0947EB8
-Z(CODE)PATCH_MENU_PREDIAL_ENA=A0916950
-Z(CODE)PATCH_IDLE_START_XTRA_JC=A08C5E66
-Z(CODE)PATCH_SET_FILE_NAME=A08F04FE

-Z(CODE)PATCH_IDLE_INPUTDIA_ONKEY=A171B530
-Z(CODE)PATCH_IDLE_INPUTDIA_GHOOK=A171B870
