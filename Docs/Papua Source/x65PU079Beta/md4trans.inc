		mov	eax, [edi]
		mov	ebx, [edi+4]
		push	edi
		mov	ecx, [edi+8]
		mov	edx, [edi+0Ch]
		mov	edi, ecx
		xor	edi, edx
		and	edi, ebx
		mov	ebp, [esi]
		xor	edi, edx
		add	eax, ebp
		mov	ebp, ebx
		add	eax, edi
		rol	eax, 3
		xor	ebp, ecx
		mov	edi, [esi+4]
		and	ebp, eax
		add	edx, edi
		xor	ebp, ecx
		mov	edi, eax
		add	edx, ebp
		xor	edi, ebx
		rol	edx, 7
		and	edi, edx
		mov	ebp, [esi+8]
		xor	edi, ebx
		add	ecx, ebp
		mov	ebp, edx
		add	ecx, edi
		rol	ecx, 0Bh
		xor	ebp, eax
		mov	edi, [esi+0Ch]
		and	ebp, ecx
		add	ebx, edi
		xor	ebp, eax
		mov	edi, ecx
		add	ebx, ebp
		xor	edi, edx
		ror	ebx, 0Dh
		and	edi, ebx
		mov	ebp, [esi+10h]
		xor	edi, edx
		add	eax, ebp
		mov	ebp, ebx
		add	eax, edi
		rol	eax, 3
		xor	ebp, ecx
		mov	edi, [esi+14h]
		and	ebp, eax
		add	edx, edi
		xor	ebp, ecx
		mov	edi, eax
		add	edx, ebp
		xor	edi, ebx
		rol	edx, 7
		and	edi, edx
		mov	ebp, [esi+18h]
		xor	edi, ebx
		add	ecx, ebp
		mov	ebp, edx
		add	ecx, edi
		rol	ecx, 0Bh
		xor	ebp, eax
		mov	edi, [esi+1Ch]
		and	ebp, ecx
		add	ebx, edi
		xor	ebp, eax
		mov	edi, ecx
		add	ebx, ebp
		xor	edi, edx
		ror	ebx, 0Dh
		and	edi, ebx
		mov	ebp, [esi+20h]
		xor	edi, edx
		add	eax, ebp
		mov	ebp, ebx
		add	eax, edi
		rol	eax, 3
		xor	ebp, ecx
		mov	edi, [esi+24h]
		and	ebp, eax
		add	edx, edi
		xor	ebp, ecx
		mov	edi, eax
		add	edx, ebp
		xor	edi, ebx
		rol	edx, 7
		and	edi, edx
		mov	ebp, [esi+28h]
		xor	edi, ebx
		add	ecx, ebp
		mov	ebp, edx
		add	ecx, edi
		rol	ecx, 0Bh
		xor	ebp, eax
		mov	edi, [esi+2Ch]
		and	ebp, ecx
		add	ebx, edi
		xor	ebp, eax
		mov	edi, ecx
		add	ebx, ebp
		xor	edi, edx
		ror	ebx, 0Dh
		and	edi, ebx
		mov	ebp, [esi+30h]
		xor	edi, edx
		add	eax, ebp
		mov	ebp, ebx
		add	eax, edi
		rol	eax, 3
		xor	ebp, ecx
		mov	edi, [esi+34h]
		and	ebp, eax
		add	edx, edi
		xor	ebp, ecx
		mov	edi, eax
		add	edx, ebp
		xor	edi, ebx
		rol	edx, 7
		and	edi, edx
		mov	ebp, [esi+38h]
		xor	edi, ebx
		add	ecx, ebp
		mov	ebp, edx
		add	ecx, edi
		rol	ecx, 0Bh
		xor	ebp, eax
		mov	edi, [esi+3Ch]
		and	ebp, ecx
		add	ebx, edi
		xor	ebp, eax
		mov	edi, edx
		add	ebx, ebp
		mov	ebp, edx
		ror	ebx, 0Dh
		or	edi, ecx
		and	ebp, ecx
		and	edi, ebx
		add	eax, [esi]
		or	edi, ebp
		mov	ebp, ecx
		lea	eax, [eax+edi+5A827999h]
		mov	edi, ecx
		rol	eax, 3
		or	edi, ebx
		and	ebp, ebx
		and	edi, eax
		add	edx, [esi+10h]
		or	edi, ebp
		mov	ebp, ebx
		lea	edx, [edx+edi+5A827999h]
		mov	edi, ebx
		rol	edx, 5
		or	edi, eax
		and	ebp, eax
		and	edi, edx
		add	ecx, [esi+20h]
		or	edi, ebp
		mov	ebp, eax
		lea	ecx, [ecx+edi+5A827999h]
		mov	edi, eax
		rol	ecx, 9
		or	edi, edx
		and	ebp, edx
		and	edi, ecx
		add	ebx, [esi+30h]
		or	edi, ebp
		mov	ebp, edx
		lea	ebx, [ebx+edi+5A827999h]
		mov	edi, edx
		rol	ebx, 0Dh
		or	edi, ecx
		and	ebp, ecx
		and	edi, ebx
		add	eax, [esi+4]
		or	edi, ebp
		mov	ebp, ecx
		lea	eax, [eax+edi+5A827999h]
		mov	edi, ecx
		rol	eax, 3
		or	edi, ebx
		and	ebp, ebx
		and	edi, eax
		add	edx, [esi+14h]
		or	edi, ebp
		mov	ebp, ebx
		lea	edx, [edx+edi+5A827999h]
		mov	edi, ebx
		rol	edx, 5
		or	edi, eax
		and	ebp, eax
		and	edi, edx
		add	ecx, [esi+24h]
		or	edi, ebp
		mov	ebp, eax
		lea	ecx, [ecx+edi+5A827999h]
		mov	edi, eax
		rol	ecx, 9
		or	edi, edx
		and	ebp, edx
		and	edi, ecx
		add	ebx, [esi+34h]
		or	edi, ebp
		mov	ebp, edx
		lea	ebx, [ebx+edi+5A827999h]
		mov	edi, edx
		rol	ebx, 0Dh
		or	edi, ecx
		and	ebp, ecx
		and	edi, ebx
		add	eax, [esi+8]
		or	edi, ebp
		mov	ebp, ecx
		lea	eax, [eax+edi+5A827999h]
		mov	edi, ecx
		rol	eax, 3
		or	edi, ebx
		and	ebp, ebx
		and	edi, eax
		add	edx, [esi+18h]
		or	edi, ebp
		mov	ebp, ebx
		lea	edx, [edx+edi+5A827999h]
		mov	edi, ebx
		rol	edx, 5
		or	edi, eax
		and	ebp, eax
		and	edi, edx
		add	ecx, [esi+28h]
		or	edi, ebp
		mov	ebp, eax
		lea	ecx, [ecx+edi+5A827999h]
		mov	edi, eax
		rol	ecx, 9
		or	edi, edx
		and	ebp, edx
		and	edi, ecx
		add	ebx, [esi+38h]
		or	edi, ebp
		mov	ebp, edx
		lea	ebx, [ebx+edi+5A827999h]
		mov	edi, edx
		rol	ebx, 0Dh
		or	edi, ecx
		and	ebp, ecx
		and	edi, ebx
		add	eax, [esi+0Ch]
		or	edi, ebp
		mov	ebp, ecx
		lea	eax, [eax+edi+5A827999h]
		mov	edi, ecx
		rol	eax, 3
		or	edi, ebx
		and	ebp, ebx
		and	edi, eax
		add	edx, [esi+1Ch]
		or	edi, ebp
		mov	ebp, ebx
		lea	edx, [edx+edi+5A827999h]
		mov	edi, ebx
		rol	edx, 5
		or	edi, eax
		and	ebp, eax
		and	edi, edx
		add	ecx, [esi+2Ch]
		or	edi, ebp
		mov	ebp, eax
		lea	ecx, [ecx+edi+5A827999h]
		mov	edi, eax
		rol	ecx, 9
		or	edi, edx
		and	ebp, edx
		and	edi, ecx
		add	ebx, [esi+3Ch]
		or	edi, ebp
		mov	ebp, edx
		lea	ebx, [ebx+edi+5A827999h]
		mov	edi, edx
		rol	ebx, 0Dh
		xor	edi, ecx
		mov	ebp, [esi]
		xor	edi, ebx
		add	eax, ebp
		lea	eax, [eax+edi+6ED9EBA1h]
		mov	ebp, ecx
		rol	eax, 3
		xor	ebp, ebx
		mov	edi, [esi+20h]
		xor	ebp, eax
		add	edx, edi
		lea	edx, [edx+ebp+6ED9EBA1h]
		mov	edi, ebx
		rol	edx, 9
		xor	edi, eax
		mov	ebp, [esi+10h]
		xor	edi, edx
		add	ecx, ebp
		lea	ecx, [ecx+edi+6ED9EBA1h]
		mov	ebp, eax
		rol	ecx, 0Bh
		xor	ebp, edx
		mov	edi, [esi+30h]
		xor	ebp, ecx
		add	ebx, edi
		lea	ebx, [ebx+ebp+6ED9EBA1h]
		mov	edi, edx
		rol	ebx, 0Fh
		xor	edi, ecx
		mov	ebp, [esi+8]
		xor	edi, ebx
		add	eax, ebp
		lea	eax, [eax+edi+6ED9EBA1h]
		mov	ebp, ecx
		rol	eax, 3
		xor	ebp, ebx
		mov	edi, [esi+28h]
		xor	ebp, eax
		add	edx, edi
		lea	edx, [edx+ebp+6ED9EBA1h]
		mov	edi, ebx
		rol	edx, 9
		xor	edi, eax
		mov	ebp, [esi+18h]
		xor	edi, edx
		add	ecx, ebp
		lea	ecx, [ecx+edi+6ED9EBA1h]
		mov	ebp, eax
		rol	ecx, 0Bh
		xor	ebp, edx
		mov	edi, [esi+38h]
		xor	ebp, ecx
		add	ebx, edi
		lea	ebx, [ebx+ebp+6ED9EBA1h]
		mov	edi, edx
		rol	ebx, 0Fh
		xor	edi, ecx
		mov	ebp, [esi+4]
		xor	edi, ebx
		add	eax, ebp
		lea	eax, [eax+edi+6ED9EBA1h]
		mov	ebp, ecx
		rol	eax, 3
		xor	ebp, ebx
		mov	edi, [esi+24h]
		xor	ebp, eax
		add	edx, edi
		lea	edx, [edx+ebp+6ED9EBA1h]
		mov	edi, ebx
		rol	edx, 9
		xor	edi, eax
		mov	ebp, [esi+14h]
		xor	edi, edx
		add	ecx, ebp
		lea	ecx, [ecx+edi+6ED9EBA1h]
		mov	ebp, eax
		rol	ecx, 0Bh
		xor	ebp, edx
		mov	edi, [esi+34h]
		xor	ebp, ecx
		add	ebx, edi
		lea	ebx, [ebx+ebp+6ED9EBA1h]
		mov	edi, edx
		rol	ebx, 0Fh
		xor	edi, ecx
		mov	ebp, [esi+0Ch]
		xor	edi, ebx
		add	eax, ebp
		lea	eax, [eax+edi+6ED9EBA1h]
		mov	ebp, ecx
		rol	eax, 3
		xor	ebp, ebx
		mov	edi, [esi+2Ch]
		xor	ebp, eax
		add	edx, edi
		lea	edx, [edx+ebp+6ED9EBA1h]
		mov	edi, ebx
		rol	edx, 9
		xor	edi, eax
		mov	ebp, [esi+1Ch]
		xor	edi, edx
		add	ecx, ebp
		lea	ecx, [ecx+edi+6ED9EBA1h]
		mov	ebp, eax
		rol	ecx, 0Bh
		xor	ebp, edx
		mov	edi, [esi+3Ch]
		xor	ebp, ecx
		add	ebx, edi
		lea	ebx, [ebx+ebp+6ED9EBA1h]
		rol	ebx, 0Fh
		pop	edi
		add	[edi], eax
		add	[edi+4], ebx
		add	[edi+8], ecx
		add	[edi+0Ch], edx
