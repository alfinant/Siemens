-carm
-Z(CODE)CODE,DATA_C,DATA_I,DATA_ID,INITTAB=A144B800 //свободое место в прошивке
//-Z(CODE)PATCH_NUM_CIPHERS=A0F86E80
-Z(CODE)PATCH_CIPHER_0x0B=A1103F34 //7F 00 00 00 00 00 00 00 ?? ?? ?? ?? 0B 00 00 03 +4
-Z(CODE)PATCH_SSL_GET_DISABLED=A0F8DE70 //00 20 01 43 01 20 52 68 80 04 00 2A ?? ?? 00 20 08 43 70 47 +0xC
-Z(CODE)PATCH_SSL_CIPHER_GET_EVP=A0F88D9C //16 1C 1D 1C 0C 1C 00 2F ?? ?? 00 2D -6
-Z(CODE)SSL_CIPHER_GET_EVP__CODE_AREA=A0F88DA8-A0F88E74 //16 1C 1D 1C 0C 1C 00 2F ?? ?? 00 2D +6
-Z(CODE)PATCH_SSL_LIBRARY_INIT=A0F8DB28 //00 28 01 D0 40 68 70 47 64 A0 70 47 4A 49 01 20 08 62 00 20 C8 61 +0x2E
-Z(CODE)PATCH_LOAD_CIPHERS=A0F8DEA6 //E0 60 21 A0 ?? ?? ?? ?? 20 61 22 48 +4
-Z(CODE)PATCH_EVP_CIPHERINIT=A0E8EC34 //00 20 A0 60 65 60 70 BD 10 B5 02 9C 00 2C +8
