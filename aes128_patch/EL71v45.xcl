-carm
-Z(CODE)CODE,DATA_C,DATA_I,DATA_ID,INITTAB=A12FDBB0
-Z(CODE)PATCH_CIPHER_0x0B=A10C4020 
-Z(CODE)PATCH_SSL_GET_DISABLED=A0F85890
-Z(CODE)PATCH_SSL_CIPHER_GET_EVP=A0F807BC
-Z(CODE)SSL_CIPHER_GET_EVP__CODE_AREA=A0F807C8-A0F80894
-Z(CODE)PATCH_SSL_LIBRARY_INIT=A0F85548
-Z(CODE)PATCH_LOAD_CIPHERS=A0F858C6
-Z(CODE)PATCH_EVP_CIPHERINIT=A0E7FC04
