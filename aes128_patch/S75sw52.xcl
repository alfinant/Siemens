-carm
//A1448470
-Z(CODE)CODE,DATA_C,DATA_I,DATA_ID,INITTAB=A144B800
//-Z(CODE)PATCH_NUM_CIPHERS=A0F86E80
-Z(CODE)PATCH_STRING_EXP_DH_DSS_DES_CBC_SHA=A1104369
-Z(CODE)PATCH_CIPHER_0x0B=A1103F34
-Z(CODE)PATCH_SSL_GET_DISABLED=A0F8DE70
-Z(CODE)PATCH_SSL_CIPHER_GET_EVP=A0F88D9C
-Z(CODE)SSL_CIPHER_GET_EVP__CODE_AREA=A0F88DA8-A0F88E74
-Z(CODE)PATCH_SSL_LIBRARY_INIT=A0F8DB28
-Z(CODE)PATCH_LOAD_CIPHERS=A0F8DEA6
-Z(CODE)PATCH_EVP_CIPHERINIT=A0E8EC34